## conf/machine/raspberrypi4-rdk-extender.conf
```bitbake
#@TYPE: Machine
#@NAME: raspberrypi-rdk-extender-rpi4
#@NEEDED_BSPLAYERS: meta-cmf-raspberrypi
#@DESCRIPTION: Machine configuration for running a RDK Extender on Raspberry Pi 4
#@RDK_FLAVOR: rdkb

include conf/machine/raspberrypi4.conf

MACHINEOVERRIDES .= ":raspberrypi4:rpi:extender"

# required for image creation
MACHINE_IMAGE_NAME = "rdk-generic-extender-image"

SERIAL_CONSOLE = "115200 ttyAMA0"

#MACHINE_EXTRA_RRECOMMENDS += "kernel-modules linux-firmware-bcm43430 linux-firmware-bcm43455"
MACHINE_EXTRA_RRECOMMENDS += "kernel-module-8192eu kernel-module-rtl8812au kernel-module-88x2bu"

KERNEL_IMAGETYPE = "zImage"

#IMAGE_BOOT_FILES = "bcm2835-bootfiles/* ${KERNEL_IMAGETYPE};${SDIMG_KERNELIMAGE}"
IMAGE_BOOT_FILES = "bcm2711-rpi-4-b.dtb bootfiles/* ${KERNEL_IMAGETYPE};${SDIMG_KERNELIMAGE}"

KERNEL_DEFCONFIG ?= "bcm2711_defconfig"

DISTRO_FEATURES_append = " extender"
#DISTRO_FEATURES_remove = "telemetry2_0"

PREFERRED_PROVIDER_hal-wifi = "hal-wifi-cfg80211"

do_image_wic[depends] += " rpi-config:do_deploy"

PREFERRED_VERSION_linux-raspberrypi_dunfell = "5.10.%"
PREFERRED_VERSION_linux-libc-headers_dunfell = "5.10.%"

MACHINE_FEATURES_remove = "vc4graphics"

# Heam enabled distro

DISTRO_FEATURES_append = " halVersion3"

# OneWifi feature
DISTRO_FEATURES_append = " OneWifi onewifi_integration"

# MacFilter Feature
DISTRO_FEATURES_append = " acl_nl_support"

#No Moca Support
DISTRO_FEATURES_append = " no_moca_support"
DISTRO_FEATURES_append = " referencepltfm "

MACHINEOVERRIDES_append = "${@bb.utils.contains('DISTRO_FEATURES', 'OneWifi', ':onewifi', '' ,d)}"

DISTRO_FEATURES_append = " partner_default_ext"

# Define extender feature
DISTRO_FEATURES_append = " em_extender"

# Easymesh
DISTRO_FEATURES_append = " EasyMesh"
DISTRO_FEATURES_append = " sta_manager"

PREFERRED_PROVIDER_hal-wifi_onewifi = "hal-wifi-generic"
DISTRO_FEATURES_append = " rdkb_wan_manager"

# MLO
DISTRO_FEATURES_append = " CONFIG_IEEE80211BE"
DISTRO_FEATURES_append = " generic_mlo"
DISTRO_FEATURES_append = " HOSTAPD_2_10"


require conf/include/rdk-bbmasks-rdkb-extender-platform.inc
```
